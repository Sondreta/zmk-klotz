## config/boards/shields/murphpad/Kconfig.defconfig
```kconfig
# Copyright (c) 2021 The ZMK Contributors
# SPDX-License-Identifier: MIT

if SHIELD_MURPHPAD

config ZMK_KEYBOARD_NAME
    default "MurphPad"

endif
```
